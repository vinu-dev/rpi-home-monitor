## meta-home-monitor/conf/distro/home-monitor.conf
```bitbake
# =============================================================
# home-monitor.conf — Custom distribution for Home Monitor OS
#
# This replaces DISTRO="poky" with a product-specific distro
# that controls all system policy in one place.
# =============================================================

DISTRO = "home-monitor"
DISTRO_NAME = "Home Monitor OS"
# Single source of truth for the release version: ``VERSION`` at the
# repo root. Bumping a release is therefore one edit (or
# ``./scripts/release.sh prepare X.Y.Z``) — no scattered edits across
# distro conf, sw-description, CHANGELOG headers, etc. This string is
# stamped into /etc/os-release on-device and surfaces in the admin
# UI's "Current version" line. The git tag the release artefacts are
# built from must match this value (release.sh enforces).
DISTRO_VERSION := "${@open(d.getVar('HOME_MONITOR_LAYERDIR') + '/../VERSION').read().strip()}"
DISTRO_CODENAME = "phase1"

# Pin BUILD_ID to the static DISTRO_VERSION. poky's os-release.bb
# defaults BUILD_ID to a DATETIME-based expression, which was the
# most likely source of the basehash non-determinism that produced
# 30× "metadata is not deterministic" warnings per bitbake run in
# v1.2.1 release builds. Pinning it eliminates the date-dependent
# input to the task hash and makes os-release.bb reproducible.
BUILD_ID = "${DISTRO_VERSION}"

# Maintainer
MAINTAINER = "vinu@engineer.com"

# --- System fundamentals ---
DISTRO_FEATURES = " \
    ipv4 \
    ipv6 \
    wifi \
    systemd \
    usrmerge \
    seccomp \
    pam \
    nfs \
    zeroconf \
    "

# Remove sysvinit backfill — we use systemd exclusively
DISTRO_FEATURES_BACKFILL_CONSIDERED = "sysvinit"

# --- Init system ---
VIRTUAL-RUNTIME_init_manager = "systemd"
VIRTUAL-RUNTIME_initscripts = "systemd-compat-units"
VIRTUAL-RUNTIME_login_manager = "shadow-base"

# --- Boot: U-Boot for A/B OTA partition switching (ADR-0008) ---
RPI_USE_U_BOOT = "1"

# --- Package management ---
PACKAGE_CLASSES = "package_deb"

# --- Licensing ---
LICENSE_FLAGS_ACCEPTED = "synaptics-killswitch commercial"

# --- Image defaults ---
# No debug tweaks by default — dev images add them explicitly
EXTRA_IMAGE_FEATURES ?= ""

# --- Build reproducibility ---
INHERIT += "create-spdx"
INHERIT += "rm_work"
# Keep image deploy artifacts (ext4.gz needed for SWU packaging)
RM_WORK_EXCLUDE += "home-monitor-image home-monitor-image-dev home-monitor-image-prod home-camera-image home-camera-image-dev home-camera-image-prod"

# --- Version pinning for critical packages ---
PREFERRED_VERSION_linux-raspberrypi = "6.6%"
PREFERRED_VERSION_python3 = "3.12%"
PREFERRED_VERSION_openssl = "3.5%"

# --- FFmpeg: use upstream 6.1.4 from poky instead of rpidistro-ffmpeg 4.3.4 ---
# rpidistro-ffmpeg 4.3 cannot probe raw H.264 streams (fails with
# "unspecified size") and lacks RTSP muxer TLS options (-tls_cert/-tls_key).
# Upstream ffmpeg 6.1.4 fixes both issues. The RPi-specific patches in
# rpidistro (MMAL, sand format) are not needed — we use libcamera-vid for
# capture and ffmpeg only does stream copy.
PREFERRED_PROVIDER_ffmpeg = "ffmpeg"
PREFERRED_PROVIDER_libav = "ffmpeg"
PREFERRED_PROVIDER_libpostproc = "ffmpeg"
BBMASK += "meta-raspberrypi/recipes-multimedia/rpidistro-ffmpeg"

# --- Disk space monitor ---
BB_DISKMON_DIRS ??= "\
    STOPTASKS,${TMPDIR},1G,100K \
    STOPTASKS,${DL_DIR},1G,100K \
    STOPTASKS,${SSTATE_DIR},1G,100K \
    STOPTASKS,/tmp,100M,100K \
    HALT,${TMPDIR},100M,1K \
    HALT,${DL_DIR},100M,1K \
    HALT,${SSTATE_DIR},100M,1K \
    HALT,/tmp,10M,1K"
```

## meta-home-monitor/conf/layer.conf
```bitbake
# REQ: SWR-046, SWR-049, SWR-050; RISK: RISK-018, RISK-019; SEC: SC-018, SC-019; TEST: TC-043, TC-044, TC-047
# Layer configuration for meta-home-monitor
BBPATH .= ":${LAYERDIR}"

BBFILES += " \
    ${LAYERDIR}/recipes-*/*/*.bb \
    ${LAYERDIR}/recipes-*/*/*.bbappend \
    "

BBFILE_COLLECTIONS += "home-monitor"
BBFILE_PATTERN_home-monitor = "^${LAYERDIR}/"
BBFILE_PRIORITY_home-monitor = "10"

LAYERDEPENDS_home-monitor = " \
    core \
    meta-python \
    networking-layer \
    multimedia-layer \
    webserver \
    raspberrypi \
    "
LAYERSERIES_COMPAT_home-monitor = "scarthgap"

# Re-export this layer's directory so other conf files in the layer
# can resolve repo-root-relative paths reliably. ``LAYERDIR`` itself
# is only bound while THIS file is being parsed; by the time the
# distro conf (``conf/distro/home-monitor.conf``) is processed,
# bitbake has moved on to other layers and ``getVar('LAYERDIR')``
# returns ``None``. Snapshot it under a layer-specific name so the
# distro conf can read the repo-root ``VERSION`` file.
HOME_MONITOR_LAYERDIR := "${LAYERDIR}"
```

## meta-home-monitor/conf/machine/home-monitor-camera.conf
```bitbake
#@TYPE: Machine
#@NAME: Home Monitor Camera (Raspberry Pi Zero 2 W)
#@DESCRIPTION: Home Monitor camera machine based on raspberrypi0-2w-64. \
#The Pi firmware detects the connected sensor at boot via i2c probe \
#and loads the matching overlay automatically. All Pi-officially- \
#supported sensors that ship with overlays in meta-raspberrypi work \
#out of the box (OV5647 / IMX219 / IMX477 / IMX708) — no rebuild on \
#sensor swap.

require conf/machine/raspberrypi0-2w-64.conf

# --- Device-tree overlays shipped in the boot partition ------------
#
# meta-raspberrypi already installs all of these by default; the
# :append below is a belt-and-braces pin so a future change to the
# upstream overlay set cannot silently drop one we rely on.
#
# Adding a new sensor to this list does NOT require rebuilding the
# kernel — the .dtbo files are loaded by the firmware at boot, after
# the SoC has identified which sensor is on the CSI ribbon.
RPI_KERNEL_DEVICETREE_OVERLAYS:append = " \
    overlays/ov5647.dtbo \
    overlays/imx219.dtbo \
    overlays/imx477.dtbo \
    overlays/imx708.dtbo \
    "

# --- Sensor selection: firmware auto-detect ------------------------
#
# `camera_auto_detect=1` tells the Pi firmware to probe the CSI bus
# at boot and load the matching overlay. This works for both EEPROM-
# carrying boards (Camera Module 2/3, HQ) and the EEPROM-less PiHut
# ZeroCam (OV5647) — the firmware also performs an i2c chip-id scan
# at known sensor addresses and recognises the OV5647 even without
# its EEPROM.
#
# An explicit override is available at runtime: drop a sensor name
# into /data/config/camera-sensor (one of: ov5647, imx219, imx477,
# imx708) and ensure-camera-overlay.service will pin that overlay
# on the next boot. Useful for bring-up, weird ribbons, or a sensor
# whose auto-detect path has not yet been validated. The file lives
# on /data so it survives OTAs by design.
RPI_EXTRA_CONFIG += " \n camera_auto_detect=1 \n "
```

## meta-home-monitor/wic/home-camera-ab.wks
```
# Partition layout for RPi Zero 2W Camera Node (A/B OTA)
#
# Part 1: boot    (100MB, vfat)  - kernel, DTBs, config.txt
# Part 2: rootfsA (1GB, ext4)    - active root filesystem
# Part 3: rootfsB (1GB, ext4)    - standby root (OTA target)
# Part 4: data    (256MB, ext4)  - config, certs (LUKS in production)

part /boot --source bootimg-partition --ondisk mmcblk0 --fstype=vfat --label boot --active --align 4096 --size 100M
part / --source rootfs --ondisk mmcblk0 --fstype=ext4 --label rootfsA --align 4096 --size 1024M
part --ondisk mmcblk0 --fstype=ext4 --label rootfsB --align 4096 --size 1024M
part /data --ondisk mmcblk0 --fstype=ext4 --label data --align 4096 --size 256M
```

## meta-home-monitor/wic/home-monitor-ab-luks.wks
```
# Partition layout for RPi 4B Home Monitor Server — Production (LUKS)
#
# Target SD card: 64 GB (minimum 32 GB)
#
# Part 1: boot    (512MB, vfat)  - U-Boot, kernel, DTBs, config.txt, U-Boot env
# Part 2: rootfsA (8GB, ext4)    - active root filesystem
# Part 3: rootfsB (8GB, ext4)    - standby root (OTA target)
# Part 4: data    (4GB, ext4)    - config, certs, updates
#
# /data ships as ext4 so fstab mount + local-fs.target succeed on
# fresh boot, which is the precondition for monitor-hotspot.service.
# LUKS migration (ADR-0010) now runs POST-setup instead of blocking
# first-boot — see docs/exec-plans/luks-post-pair.md. This avoids a
# class of bugs where the LUKS first-boot chain failed silently
# (missing passphrase, detached console, etc.) and left /data
# unformatted, which made local-fs.target hang and the setup
# hotspot never come up.

part /boot --source bootimg-partition --ondisk mmcblk0 --fstype=vfat --label boot --active --align 4096 --size 512M
part / --source rootfs --ondisk mmcblk0 --fstype=ext4 --label rootfsA --align 4096 --size 8192M
part --ondisk mmcblk0 --fstype=ext4 --label rootfsB --align 4096 --size 8192M
part /data --ondisk mmcblk0 --fstype=ext4 --label data --align 4096 --size 4096M
```
